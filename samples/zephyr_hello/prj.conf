## CMakeLists.txt
```
cmake_minimum_required(VERSION 3.20.0)

find_package(Zephyr REQUIRED HINTS $ENV{ZEPHYR_BASE})
project(synapse32_zephyr_hello)

target_sources(app PRIVATE src/main.c)
```

## prj.conf
```kconfig
CONFIG_PRINTK=y
CONFIG_STDOUT_CONSOLE=y
CONFIG_MINIMAL_LIBC=y
```

## src/main.c
```c
#include <zephyr/kernel.h>

int main(void)
{
	printk("Hello World from Synapse32\n");
	return 0;
}
```
