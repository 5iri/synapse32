## zephyr/boards/synapse32/synapse32_sim/board.yml
```yaml
board:
  name: synapse32_sim
  full_name: Synapse32 cocotb simulator
  vendor: synapse32
  socs:
    - name: synapse32
```

## zephyr/boards/synapse32/synapse32_sim/synapse32_sim_synapse32_defconfig
```kconfig
CONFIG_MAIN_STACK_SIZE=1024
CONFIG_IDLE_STACK_SIZE=512
CONFIG_ISR_STACK_SIZE=1024

CONFIG_SERIAL=y
CONFIG_CONSOLE=y
CONFIG_UART_CONSOLE=y
CONFIG_UART_SYNAPSE32=y
CONFIG_STDOUT_CONSOLE=y
CONFIG_PRINTK=y

CONFIG_XIP=y
CONFIG_INCLUDE_RESET_VECTOR=y
```

## zephyr/drivers/serial/Kconfig
```kconfig
config UART_SYNAPSE32
	bool "Synapse32 UART driver"
	default y
	depends on DT_HAS_SYNAPSE32_UART_ENABLED
	select SERIAL_HAS_DRIVER
	help
	  Enable the Synapse32 polling UART driver (TX-only).
```

## zephyr/dts/bindings/serial/synapse32,uart.yaml
```yaml
description: Synapse32 UART (TX-only polling)

compatible: "synapse32,uart"

include: [uart-controller.yaml, base.yaml]

properties:
  reg:
    required: true
  current-speed:
    required: true
  clock-frequency:
    type: int
    description: Source clock for baud divisor (defaults to cpu clock-frequency)
```

## zephyr/soc/synapse32/synapse32/Kconfig
```kconfig
config SOC_SYNAPSE32
	select RISCV
	select RISCV_PRIVILEGED
	select RISCV_ISA_RV32I
	select RISCV_ISA_EXT_ZICSR
	select RISCV_ISA_EXT_ZIFENCEI
	select ATOMIC_OPERATIONS_C
	select INCLUDE_RESET_VECTOR
	select RISCV_SOC_HAS_GP_RELATIVE_ADDRESSING
	imply XIP
```

## zephyr/soc/synapse32/synapse32/Kconfig.defconfig
```kconfig
if SOC_SYNAPSE32

config SYS_CLOCK_HW_CYCLES_PER_SEC
	default $(dt_node_int_prop_int,/cpus/cpu@0,clock-frequency)

config NUM_IRQS
	default 16

endif # SOC_SYNAPSE32
```

## zephyr/soc/synapse32/synapse32/Kconfig.soc
```kconfig
config SOC_SYNAPSE32
	bool
	help
	  Synapse32 RV32I CPU (RV32I + Zicsr + Zifencei).

config SOC_FAMILY_SYNAPSE32
	bool

config SOC_FAMILY
	default "synapse32" if SOC_FAMILY_SYNAPSE32

config SOC
	default "synapse32" if SOC_SYNAPSE32
```
